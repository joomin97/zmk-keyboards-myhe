## boards/shields/myhe/Kconfig.defconfig
```kconfig
if SHIELD_MYHE_LEFT

config ZMK_KEYBOARD_NAME
    default "myhe left"

endif

if SHIELD_MYHE_RIGHT

config ZMK_KEYBOARD_NAME
    default "myhe right"

endif

if SHIELD_MYHE_LEFT || SHIELD_MYHE_RIGHT

config ZMK_SPLIT
    default y

endif
```

## boards/shields/myhe/Kconfig.shield
```kconfig
config SHIELD_MYHE_LEFT
    def_bool $(shields_list_contains,myhe_left)

config SHIELD_MYHE_RIGHT
    def_bool $(shields_list_contains,myhe_right)
```
